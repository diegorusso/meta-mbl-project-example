## conf/layer.conf
```bitbake
BBPATH .= ":${LAYERDIR}"
BBFILES += "${LAYERDIR}/recipes*/*/*.bb ${LAYERDIR}/recipes*/*/*.bbappend"
BBFILE_COLLECTIONS += "meta-mbl-project-example"
BBFILE_PATTERN_meta-mbl-project-example := "^${LAYERDIR}/"

LAYERSERIES_COMPAT_meta-mbl-project-example = "warrior"
LAYERDEPENDS_meta-mbl-project-example = "meta-mbl-distro"
```
